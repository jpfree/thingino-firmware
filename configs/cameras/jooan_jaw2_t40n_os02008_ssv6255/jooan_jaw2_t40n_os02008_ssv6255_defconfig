## configs/cameras/jooan_jaw2_t40n_os02008_ssv6255/jooan_jaw2_t40n_os02008_ssv6255_defconfig
```kconfig
# NAME: Jooan JA-W2 (T40N, MIS2008, SSV6255)
# FRAG: soc-xburst2 toolchain-xburst2 ccache brand rootfs kernel system target uboot ssl
BR2_ETHERNET=y
BR2_SENSOR_MIS2008=y
BR2_SOC_INGENIC_T40N=y
BR2_PACKAGE_WIFI=y
BR2_PACKAGE_WIFI_SSV6X5X=y
BR2_PACKAGE_WIFI_SSV6X5X_SV6256P=y
BR2_THINGINO_AUDIO=y
BR2_THINGINO_BUTTON=y
BR2_THINGINO_FLASH_NOR=y
BR2_THINGINO_SDCARD=y
FLASH_SIZE_8=y
```
